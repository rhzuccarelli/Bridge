## firmware/esp32p4/tp7-audio-probe/main/Kconfig.projbuild
```kconfig
menu "TP-7 audio probe"

    config PROBE_VBUS_ENABLE_GPIO
        int "GPIO that enables 5 V VBUS on the host socket (-1 = none)"
        range -1 54
        default -1

    config PROBE_HIGH_BANDWIDTH
        bool "Program two transactions per microframe on the playback channel"
        default y
        help
            The TP-7's playback endpoint moves up to 2 x 882 bytes per microframe.
            ESP-IDF v5.5.1 never programs the channel's multi-count, so the probe
            writes it directly. Turn this off to see how the stream fails without it.

    config PROBE_TONE_HZ
        int "Test tone frequency (Hz)"
        range 20 20000
        default 1000

    config PROBE_TONE_DBFS
        int "Test tone level (dBFS, negative)"
        range -60 0
        default -18

    config PROBE_SECONDS
        int "Seconds to stream before stopping (0 = until detach)"
        default 60

    config PROBE_PACKETS_PER_URB
        int "1 ms packets per playback transfer"
        range 1 7
        default 4
        help
            ESP-IDF's isochronous descriptor list holds 64 microframes with 3 kept
            as margin. At one packet per millisecond (every 8 microframes), at most
            7 packets fit in one transfer.

    config PROBE_URBS_IN_FLIGHT
        int "Playback transfers kept queued"
        range 2 8
        default 3

endmenu
```

## firmware/esp32p4/tp7-probe/main/Kconfig.projbuild
```kconfig
menu "TP-7 probe"

    choice PROBE_USB_PORT
        prompt "USB peripheral used as host"
        default PROBE_USB_PORT_HS
        help
            The ESP32-P4 has two USB OTG controllers. The high-speed one (480 Mbit/s,
            internal UTMI PHY) is the one Bridge needs: MTP imports are hundreds of
            megabytes and TP-7 monitor audio is 96 kHz six-channel 24-bit. The
            full-speed one (12 Mbit/s) is offered only to rule out wiring problems.

        config PROBE_USB_PORT_HS
            bool "USB 2.0 OTG high-speed (peripheral 0)"
        config PROBE_USB_PORT_FS
            bool "USB 1.1 OTG full-speed (peripheral 1)"
    endchoice

    config PROBE_VBUS_ENABLE_GPIO
        int "GPIO that enables 5 V VBUS on the host socket (-1 = none)"
        range -1 54
        default -1
        help
            Some boards gate the host socket's VBUS through a load switch driven by
            a GPIO. Without VBUS the TP-7 never signals attach. Leave at -1 when the
            socket is always powered.

    config PROBE_VBUS_ENABLE_ACTIVE_HIGH
        bool "VBUS enable is active high"
        default y
        depends on PROBE_VBUS_ENABLE_GPIO >= 0

    config PROBE_REQUEST_MTP
        bool "Switch a TP-7 in USB-audio mode into MTP mode (once per boot)"
        default y
        help
            Sends the same Teenage Engineering SysEx the Raspberry Pi build sends
            through ALSA, but as raw USB-MIDI packets on the MIDI OUT endpoint.

    config PROBE_LIST_OBJECTS
        int "Maximum root objects to list over MTP"
        default 32

    config PROBE_THROUGHPUT_MIB
        int "MiB to read with GetPartialObject for the throughput test (0 = skip)"
        default 16

endmenu
```
